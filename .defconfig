## .defconfig
```kconfig
PACKAGE_NAME=openaaa
DEBUG=1
DEBUG_SIGNAL=1
MEM_PAGE_DEBUG=1
ASM=0
CONFIG_SHARED=1
CONFIG_STATIC=1
CONFIG_THREADS=1
CONFIG_UTILS=1
CONFIG_PKGCONFIG=1
CONFIG_SWIG=0
CONFIG_JAVA=0
CONFIG_PYTHON=0
CONFIG_PHP=0
CONFIG_PERL=0
CONFIG_LIBCRYPTO=1
#CONFIG_APACHE2=1
CONFIG_TLS=1
CONFIG_HAVE_OPENSSL_RFC5705=y
CONFIG_HAVE_NSS_RFC5705=y

#CONFIG_HAVE_APACHE2=1

#APACHE2_MODULES_DIR=/opt/aaa/httpd/modules
#APACHE2_INCLUDE_DIR=/opt/aaa/httpd/include
#APACHE2_LIBRARY_DIR=/opt/aaa/httpd/lib
```
